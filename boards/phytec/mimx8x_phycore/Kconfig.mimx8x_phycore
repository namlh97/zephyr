## boards/phytec/mimx8x_phycore/Kconfig.mimx8x_phycore
```kconfig
# MIMX8X Phycore

# Copyright 2024
# SPDX-License-Identifier: Apache-2.0

config BOARD_MIMX8X_PHYCORE
	select SOC_MIMX8QX6_A35 if BOARD_MIMX8X_PHYCORE_MIMX8QX6_A35
	select SOC_PART_NUMBER_MIMX8QX6AVLFZ
```

## boards/phytec/mimx8x_phycore/mimx8x_phycore_mimx8qx6_a35_defconfig
```kconfig
# SPDX-License-Identifier: Apache-2.0

# ARM Options
CONFIG_AARCH64_IMAGE_HEADER=y

# MMU Options
CONFIG_MAX_XLAT_TABLES=24

#Memory Options
CONFIG_NOCACHE_MEMORY=y

# Zephyr Kernel Configuration
CONFIG_XIP=n
CONFIG_KERNEL_DIRECT_MAP=y

CONFIG_FIRMWARE=y
CONFIG_POWER_DOMAIN=y
CONFIG_PM_DEVICE=y

CONFIG_HEAP_MEM_POOL_SIZE=16384

# clock-related configurations
CONFIG_CLOCK_CONTROL=y

# serial-related configurations
CONFIG_SERIAL=y
CONFIG_CONSOLE=y
CONFIG_UART_CONSOLE=y
CONFIG_CONSOLE_HANDLER=y
CONFIG_UART_INTERRUPT_DRIVEN=y
```

## boards/phytec/mimx8x_phycore/mimx8x_phycore_mimx8qx6_m4_defconfig
```kconfig
# SPDX-License-Identifier: Apache-2.0

CONFIG_XIP=n

CONFIG_NXP_IRQSTEER=y

CONFIG_FIRMWARE=y
CONFIG_POWER_DOMAIN=y
CONFIG_PM_DEVICE=y

# clock-related configurations
CONFIG_CLOCK_CONTROL=y

# serial-related configurations
CONFIG_SERIAL=y
CONFIG_CONSOLE=y
CONFIG_UART_CONSOLE=y
CONFIG_CONSOLE_HANDLER=y
CONFIG_UART_INTERRUPT_DRIVEN=y
```

## drivers/clock_control/Kconfig.mcux_scu
```kconfig
# MCUXpresso SDK

# Copyright (c) 2024, NXP
# SPDX-License-Identifier: Apache-2.0

config CLOCK_CONTROL_NXP_SCU
	bool "NXP SCU driver"
	default y
	depends on DT_HAS_NXP_IMX_CLOCK_SCU_ENABLED
	help
	  Enable support for nxp scu driver.
```

## drivers/firmware/Kconfig
```kconfig
# Firmware driver configuration options

# Copyright (c) 2023
# SPDX-License-Identifier: Apache-2.0

#
# Firmware drivers
#
menuconfig FIRMWARE
	bool "FIRMWARE drivers"

if FIRMWARE

config FIRMWARE_INIT_PRIORITY
	int "Firmware init priority"
	default KERNEL_INIT_PRIORITY_OBJECTS
	help
	  Firmware driver device initialization priority.

source "drivers/firmware/Kconfig.imx_scu"

endif # FIRMWARE
```

## drivers/firmware/Kconfig.imx_scu
```kconfig
config FIRMWARE_IMX_SCU
	bool "IMX SCU Protocol driver"
	default y
	depends on DT_HAS_NXP_IMX_SCU_ENABLED
	help
	  The System Controller Firmware (SCFW) is a low-level system function
	  which runs on a dedicated Cortex-M core to provide power, clock, and
	  resource management. It exists on some i.MX8 processors. e.g. i.MX8QM
	  (QM, QP), and i.MX8QX (QXP, DX).
```

## dts/bindings/clock/nxp,imx-scu.yaml
```yaml
# Copyright (c) 2017, NXP
# SPDX-License-Identifier: Apache-2.0

description: i.MX SCU Clock IP node

compatible: "nxp,imx-clock-scu"

include: [clock-controller.yaml, base.yaml]

properties:
  "#clock-cells":
    const: 3

clock-cells:
  - name
  - gpr-id
  - value
```

## dts/bindings/ethernet/nxp,enet1g.yaml
```yaml
# Copyright 2024 NXP
# SPDX-License-Identifier: Apache-2.0

description: NXP ENET1G IP Module

compatible: "nxp,enet1g"

include: ["base.yaml"]

properties:
  reg:
    required: true

  clocks:
    required: true

  clock-frequency:
    type: int
    description: system clock frequency operation, in Hz.

  rdc:
    type: int
    description: Set the RDC(Resource Domain Controller) domain permission for this peripheral
```

## dts/bindings/ethernet/qca,ar803x.yaml
```yaml
# Copyright 2023 NXP
# SPDX-License-Identifier: Apache-2.0

description: Qualcomm AR803X Ethernet PHY device

compatible: "qca,ar803x"

include: ethernet-phy.yaml

properties:
  qca,clk-out-frequency:
    type: int
    description: Clock output frequency in Hertz.
    enum: [25000000, 50000000, 62500000, 125000000]

  qca,clk-out-strength:
    type: int
    description: Clock output driver strength.
    enum: [0, 1, 2]


  qca,disable-smarteee:
    type: boolean
    description: Disable Atheros SmartEEE feature.


  qca,keep-pll-enabled:
    type: boolean
    description: |
      If set, keep the PLL enabled even if there is no link. Useful if you
      want to use the clock output without an ethernet link.
      Only supported on the AR8031.

  qca,disable-hibernation-mode:
    type: boolean
    description: |
      Disable Atheros AR803X PHYs hibernation mode. If present, indicates
      that the hardware of PHY will not enter power saving mode when the
      cable is disconnected. And the RX_CLK always keeps outputting a
      valid clock.

  qca,smarteee-tw-us-100m:
    type: int
    description: EEE Tw parameter for 100M links.

  qca,smarteee-tw-us-1g:
    type: int
    description: EEE Tw parameter for gigabit links.

  qca,interface-type:
    type: string
    required: true
    description: Which type of phy connection the phy is set up for
    enum:
      - "mii"
      - "rmii"
      - "rgmii"
      - "rgmii-id"
      - "rgmii-rxid"
      - "rgmii-txid"

  vddio-supply:
    type: phandle
    description: |
      RGMII I/O voltage regulator (see regulator/regulator.yaml).

      The PHY supports RGMII I/O voltages of 1.5V, 1.8V and 2.5V. You can
      either connect this to the vddio-regulator (1.5V / 1.8V) or the
      vddh-regulator (2.5V).

      Only supported on the AR8031.

  reset-gpios:
    type: phandle-array
    description: GPIO connected to PHY reset signal pin. Reset is active low.

  int-gpios:
    type: phandle-array
    description: GPIO for interrupt signal indicating PHY state change.
```

## dts/bindings/ethernet/ti,dp83867.yaml
```yaml
# Copyright 2023 NXP
# SPDX-License-Identifier: Apache-2.0

description: Texas Instruments DP83867 Ethernet PHY device

compatible: "ti,dp83867"

include: ethernet-phy.yaml

properties:
  ti,min-output-impedance:
    type: boolean
    description: |
       MAC Interface Impedance control to set the programmable output impedance
       to a minimum value (35 ohms).

  ti,max-output-impedance:
    type: boolean
    description: |
      MAC Interface Impedance control to set the programmable output impedance
      to a maximum value (70 ohms).
      Note: ti,min-output-impedance and ti,max-output-impedance are mutually
        exclusive. When both properties are present ti,max-output-impedance
        takes precedence.

  tx-fifo-depth:
    type: int
    description: |
       Transmitt FIFO depth see dt-bindings/net/ti-dp83867.h for values

  rx-fifo-depth:
    type: int
    description: |
       Receive FIFO depth see dt-bindings/net/ti-dp83867.h for values

  ti,clk-output-sel:
    type: int
    description: |
      Muxing option for CLK_OUT pin.  See dt-bindings/net/ti-dp83867.h
      for applicable values. The CLK_OUT pin can also be disabled by this
      property.  When omitted, the PHY's default will be left as is.

  ti,rx-internal-delay:
    type: int
    description: |
      RGMII Receive Clock Delay - see dt-bindings/net/ti-dp83867.h
      for applicable values. Required only if interface type is
      PHY_INTERFACE_MODE_RGMII_ID or PHY_INTERFACE_MODE_RGMII_RXID.

  ti,tx-internal-delay:
    type: int
    description: |
      RGMII Transmit Clock Delay - see dt-bindings/net/ti-dp83867.h
      for applicable values. Required only if interface type is
      PHY_INTERFACE_MODE_RGMII_ID or PHY_INTERFACE_MODE_RGMII_TXID.

        Note: If the interface type is PHY_INTERFACE_MODE_RGMII the TX/RX clock
          delays will be left at their default values, as set by the PHY's pin
          strapping. The default strapping will use a delay of 2.00 ns.  Thus
          PHY_INTERFACE_MODE_RGMII, by default, does not behave as RGMII with no
          internal delay, but as PHY_INTERFACE_MODE_RGMII_ID.  The device tree
          should use "rgmii-id" if internal delays are desired as this may be
          changed in future to cause "rgmii" mode to disable delays.

  ti,dp83867-rxctrl-strap-quirk:
    type: boolean
    description: |
      This denotes the fact that the board has RX_DV/RX_CTRL pin strapped in
      mode 1 or 2. To ensure PHY operation, there are specific actions that
      software needs to take when this pin is strapped in these modes.
      See data manual for details.

  ti,sgmii-ref-clock-output-enable:
    type: boolean
    description: |
      This denotes which SGMII configuration is used (4 or 6-wire modes).
      Some MACs work with differential SGMII clock. See data manual for details.

  ti,fifo-depth:
    type: int
    description: |
      Transmitt FIFO depth- see dt-bindings/net/ti-dp83867.h for applicable
      values.

  ti,enet-phy-lane-swap:
      type: boolean
      description: |
        If set, indicates the PHY will swap the TX/RX lanes to
        compensate for the board being designed with the lanes swapped.

  ti,enet-phy-lane-no-swap:
      type: boolean
      description: |
        If set, indicates that PHY will disable swap of the
        TX/RX lanes. This property allows the PHY to work correcly after e.g. 
        wrong bootstrap configuration caused by issues in PCB layout design.

  ti,led0-active-low:
    type: boolean
    description: |
      This denotes that the LED_0 pin should be driven as active low.

  ti,led1-active-low:
    type: boolean
    description: |
      This denotes that the LED_1 pin should be driven as active low.

  ti,led2-active-low:
    type: boolean
    description: |
      This denotes that the LED_2 pin should be driven as active low.

  ti,reset-gpio:
    type: phandle-array
    specifier-space: gpio
    description: GPIO connected to PHY reset signal pin. Reset is active low.

  ti,interrupt-gpio:
    type: phandle-array
    specifier-space: gpio
    description: GPIO for interrupt signal indicating PHY state change.

  ti,interface-type:
    type: string
    required: true
    description: Which type of phy connection the phy is set up for
    enum:
      - "mii"
      - "rmii"
      - "rgmii"
      - "rgmii-id"
```

## dts/bindings/firmware/nxp,imx-mu-scu.yaml
```yaml
# Copyright (c) 2017, NXP
# SPDX-License-Identifier: Apache-2.0

description: i.MX MU SCU IP node

compatible: "nxp,imx-mu-scu"

include: [base.yaml]
```

## dts/bindings/firmware/nxp,imx-pd-scu.yaml
```yaml
# Copyright (c) 2024.
# SPDX-License-Identifier: Apache-2.0

description: i.MX SCU Power domain node

compatible: "nxp,imx-pd-scu"

include: [base.yaml]
```

## dts/bindings/firmware/nxp,imx-scu.yaml
```yaml
# Copyright (c) 2017, NXP
# SPDX-License-Identifier: Apache-2.0

description: i.MX SCU IP node

compatible: "nxp,imx-scu"

include: [base.yaml]
```

## dts/bindings/power-domain/nxp,imx-scu-power-domain.yaml
```yaml
# Copyright (c) 2022 Intel Corporation
#
# SPDX-License-Identifier: Apache-2.0

description: Power domains for intel ADSP

compatible: "nxp,imx-scu-power-domain"

include: power-domain.yaml

properties:
  domain-resource:
    type: array
    required: true
    description: |
      IMX SCU Domain resources
```

## soc/nxp/imx/imx8x/Kconfig
```kconfig
# Copyright 2024 NXP
# SPDX-License-Identifier: Apache-2.0

config SOC_MIMX8QX6_ADSP
	select XTENSA
	select XTENSA_HAL if ("$(ZEPHYR_TOOLCHAIN_VARIANT)" != "xcc" && "$(ZEPHYR_TOOLCHAIN_VARIANT)" != "xt-clang")
	select XTENSA_RESET_VECTOR
	select XTENSA_USE_CORE_CRT1
	select ATOMIC_OPERATIONS_BUILTIN
	select GEN_ISR_TABLES
	select XTENSA_SMALL_VECTOR_TABLE_ENTRY
	select HAS_MCUX
	select CPU_HAS_DCACHE

config SOC_MIMX8QX6_A35
	select ARM64
	select CPU_CORTEX_A35
	select ARM_ARCH_TIMER if SYS_CLOCK_EXISTS && GIC
	select HAS_MCUX if CLOCK_CONTROL
	select HAS_MCUX_IOMUXC if PINCTRL

config SOC_MIMX8QX6_M4
	select ARM
	select CPU_CORTEX_M4
	select SOC_FAMILY_IMX
	select CPU_CORTEX_M_HAS_SYSTICK
	select CPU_CORTEX_M_HAS_VTOR
	select CPU_HAS_FPU
	select CPU_HAS_ARM_MPU
	select ARM_CUSTOM_INTERRUPT_CONTROLLER
	select HAS_MCUX

config MCUX_CORE_SUFFIX
	default "_dsp" if SOC_MIMX8QX6_ADSP
	default "_ca35" if SOC_MIMX8QX6_A35
```

## soc/nxp/imx/imx8x/Kconfig.defconfig
```kconfig
# Copyright 2024 NXP
# SPDX-License-Identifier: Apache-2.0

if SOC_SERIES_IMX8X

if SOC_MIMX8QX6_ADSP

config SYS_CLOCK_HW_CYCLES_PER_SEC
	default 640000000

config SYS_CLOCK_TICKS_PER_SEC
	default 50000

config DCACHE_LINE_SIZE
	default 128

config GEN_IRQ_VECTOR_TABLE
	default n

config CACHE_MANAGEMENT
	default y

config SMP
	default n

config XTENSA_TIMER
	default y

config KERNEL_ENTRY
	default "__start"

config MULTI_LEVEL_INTERRUPTS
	default n

config 2ND_LEVEL_INTERRUPTS
	default n

# To prevent test uses TEST_LOGGING_MINIMAL
config TEST_LOGGING_DEFAULTS
	default n
	depends on TEST

endif # SOC_MIMX8QX6_ADSP

if SOC_MIMX8QX6_A35

# Workaround for not being able to have commas in macro arguments
DT_CHOSEN_Z_FLASH := zephyr,flash

config FLASH_SIZE
	default $(dt_chosen_reg_size_int,$(DT_CHOSEN_Z_FLASH),0,K)

config FLASH_BASE_ADDRESS
	default $(dt_chosen_reg_addr_hex,$(DT_CHOSEN_Z_FLASH))

config SYS_CLOCK_HW_CYCLES_PER_SEC
	default 8000000

config DCACHE_LINE_SIZE
	default 128

config NUM_IRQS
	int
	# must be >= the highest interrupt number used
	default 544
endif # SOC_MIMX8QX6_A35

endif # SOC_SERIES_IMX8X
```
